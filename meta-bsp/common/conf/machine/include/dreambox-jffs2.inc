## meta-bsp/common/conf/machine/include/dreambox-jffs2.inc
```bitbake
EXTRA_IMAGECMD_jffs2 = "-e ${DREAMBOX_ERASE_BLOCK_SIZE} -n -l"
IMAGE_CMD_jffs2 = " \
	mkfs.jffs2 \
		--root=${IMAGE_ROOTFS}/boot \
		--faketime \
		--disable-compressor=lzo \
		--compression-mode=size \
		--output=${DEPLOY_DIR_IMAGE}/${IMAGE_NAME}.boot.jffs2 \
		${EXTRA_IMAGECMD}; \
	rm -rf ${IMAGE_ROOTFS}/boot/*; \
	printf '/dev/mtdblock2\t/boot\t\tjffs2\tro\t\t\t\t0 0\n' >> ${IMAGE_ROOTFS}/etc/fstab; \
	mkfs.jffs2 \
		--root=${IMAGE_ROOTFS} \
		--faketime \
		--disable-compressor=lzo \
		--compression-mode=size \
		--output=${DEPLOY_DIR_IMAGE}/${IMAGE_NAME}.rootfs.jffs2 \
		${EXTRA_IMAGECMD}; \
	buildimage \
		--arch ${MACHINE} \
		${EXTRA_BUILDCMD} \
		--erase-block-size ${DREAMBOX_ERASE_BLOCK_SIZE} \
		--flash-size ${DREAMBOX_FLASH_SIZE} \
		--sector-size ${DREAMBOX_SECTOR_SIZE} \
		--boot-partition ${DREAMBOX_PART0_SIZE}:${STAGING_DATADIR}/dreambox-secondstage/secondstage-${MACHINE}.bin \
		--data-partition ${DREAMBOX_PART1_SIZE}:${DEPLOY_DIR_IMAGE}/${IMAGE_NAME}.boot.jffs2 \
		--data-partition ${DREAMBOX_PART2_SIZE}:${DEPLOY_DIR_IMAGE}/${IMAGE_NAME}.rootfs.jffs2 \
		> ${DEPLOY_DIR_IMAGE}/${IMAGE_NAME}.nfi; \
"
```

## meta-bsp/common/conf/machine/include/dreambox-mipsel-nf.inc
```bitbake
# dreambox-mipsel-nf.inc

DREAMBOX_KERNEL_VERSION = "2.6.18"
LINUXLIBCVERSION = "2.6.18"
OLDEST_KERNEL = "2.6.18"

TARGET_ARCH = "mipsel"
DEFAULTTUNE = "mipsel-nf"

require conf/machine/include/dreambox.inc
require conf/machine/include/mips/arch-mips.inc
```

## meta-bsp/common/conf/machine/include/dreambox-mipsel.inc
```bitbake
# dreambox-mipsel.inc

DREAMBOX_KERNEL_VERSION = "3.2"
LINUXLIBCVERSION = "3.2"
OLDEST_KERNEL = "3.2"

TARGET_ARCH = "mipsel"
DEFAULTTUNE = "mipsel"

require conf/machine/include/dreambox.inc
require conf/machine/include/mips/arch-mips.inc
```

## meta-bsp/common/conf/machine/include/dreambox-tune-mips.inc
```bitbake
#
# - If MIPS_ARCH is the name of a MIPS ISA, i.e. it starts with "mips",
#   then use just TARGET_ARCH. Otherwise it is a processor name and will
#   be appended to it.
# - Append '-nofp' for soft-float.
#
# examples: MIPS_ARCH=4kc TARGET_ARCH=mipsel TARGET_FPU=hard -> mipsel-4kc
#           MIPS_ARCH=4kc TARGET_ARCH=mips TARGET_FPU=soft -> mips-4kc-nofp
#           MIPS_ARCH=mips32 TARGET_ARCH=mipsel TARGET_FPU=soft -> mipsel-nofp
#           MIPS_ARCH=mips64 TARGET_ARCH=mips64 TARGET_FPU=hard -> mips64
#           MIPS_ARCH=mips64 TARGET_ARCH=mips64el TARGET_FPU=hard -> mips64el
#

MIPS_CPU_SUFFIX = "${@['-${MIPS_ARCH}', ''][bb.data.getVar('MIPS_ARCH', d, 1).startswith('mips')]}"
MIPS_FP_SUFFIX = "${@['', '-nofp'][bb.data.getVar('TARGET_FPU', d, 1) == 'soft']}"
MIPS_FP_OPT = "${@['-mhard-float', '-msoft-float'][bb.data.getVar('TARGET_FPU', d, 1) == 'soft']}"
MIPS_PACKAGE_ARCH = "${TARGET_ARCH}${MIPS_CPU_SUFFIX}${MIPS_FP_SUFFIX}"

TARGET_CC_ARCH = "-march=${MIPS_ARCH} ${MIPS_FP_OPT}"

FEED_ARCH = "${MIPS_PACKAGE_ARCH}"
BASE_PACKAGE_ARCH = "${MIPS_PACKAGE_ARCH}"
PACKAGE_EXTRA_ARCHS += "${@['${MIPS_PACKAGE_ARCH}', ''][bb.data.getVar('TARGET_ARCH', d, 1) == '${MIPS_PACKAGE_ARCH}']}"
```

## meta-bsp/dm7020hd/conf/layer.conf
```bitbake
BBFILES += "${LAYERDIR}/recipes/*/*.bb"
BBFILES += "${LAYERDIR}/recipes/*/*.bbappend"
BBPATH .= ":${LAYERDIR}"
BBFILE_COLLECTIONS += "dm7020hd"
BBFILE_PRIORITY_dm7020hd = "20"
BBFILE_PATTERN_dm7020hd := "^${LAYERDIR}/"
```

## meta-bsp/dm7020hd/conf/machine/dm7020hd.conf
```bitbake
#@TYPE: Machine
#@NAME: Dreambox DM7020HD
#@DESCRIPTION: Machine configuration for the Dreambox DM7020HD

DEFAULTTUNE = "mips32el"
DREAMBOX_FEATURES = "ci dvd libpassthrough lpcm usbconsole"
DREAMBOX_NIMS = "slot"
DREAMBOX_KERNEL_VERSION = "3.0"
MACHINE_FEATURES += "modem wifi"

require conf/machine/include/dreambox-brcmnand.inc
require conf/machine/include/dreambox-nand-1024mb.inc
require conf/machine/include/dreambox-part-256mb.inc
require conf/machine/include/dreambox-jffs2-sum.inc
require conf/machine/include/dreambox-mipsel.inc
```

## meta-bsp/dm800/conf/machine/dm800.conf
```bitbake
#@TYPE: Machine
#@NAME: Dreambox DM 800 HD PVR
#@DESCRIPTION: Machine configuration for the Dreambox DM 800 HD PVR

DEFAULTTUNE = "mips32el-nf"
DREAMBOX_FEATURES = ""
DREAMBOX_NIMS = "slot"
MACHINE_FEATURES += "modem wifi"
PREFERRED_VERSION_linux-libc-headers = "2.6.18"

require conf/machine/include/dreambox-brcmnand.inc
require conf/machine/include/dreambox-nand-64mb.inc
require conf/machine/include/dreambox-part-64mb.inc
require conf/machine/include/dreambox-jffs2.inc
require conf/machine/include/dreambox-mipsel.inc
require conf/machine/include/dreambox-legacy-wlan.inc
```

## meta-bsp/dm8000/conf/layer.conf
```bitbake
BBFILES += "${LAYERDIR}/recipes/*/*.bb"
BBFILES += "${LAYERDIR}/recipes/*/*.bbappend"
BBPATH .= ":${LAYERDIR}"
BBFILE_COLLECTIONS += "dm8000"
BBFILE_PRIORITY_dm8000 = "20"
BBFILE_PATTERN_dm8000 := "^${LAYERDIR}/"
```

## meta-bsp/dm8000/conf/machine/dm8000.conf
```bitbake
#@TYPE: Machine
#@NAME: Dreambox DM 8000 HD PVR
#@DESCRIPTION: Machine configuration for the Dreambox DM 8000 HD PVR

DEFAULTTUNE = "mips32el"
DREAMBOX_FEATURES = "ci dvd libpassthrough lpcm"
DREAMBOX_NIMS = "slot"
DREAMBOX_KERNEL_VERSION = "3.0"
MACHINE_FEATURES += "pci wifi"

require conf/machine/include/dreambox-nand-256mb.inc
require conf/machine/include/dreambox-part-256mb.inc
require conf/machine/include/dreambox-jffs2-sum.inc
require conf/machine/include/dreambox-mipsel.inc
```

## meta-bsp/dm800se/conf/layer.conf
```bitbake
BBFILES += "${LAYERDIR}/recipes/*/*.bb"
BBFILES += "${LAYERDIR}/recipes/*/*.bbappend"
BBPATH .= ":${LAYERDIR}"
BBFILE_COLLECTIONS += "dm800se"
BBFILE_PRIORITY_dm800se = "20"
BBFILE_PATTERN_dm800se := "^${LAYERDIR}/"
```

## meta-bsp/dm800se/conf/machine/dm800se.conf
```bitbake
#@TYPE: Machine
#@NAME: Dreambox DM800se
#@DESCRIPTION: Machine configuration for the Dreambox DM800se

DEFAULTTUNE = "mips32el"
DREAMBOX_FEATURES = "fan libpassthrough lpcm usbconsole"
DREAMBOX_NIMS = "slot"
MACHINE_FEATURES += "modem wifi"

require conf/machine/include/dreambox-brcmnand.inc
require conf/machine/include/dreambox-nand-64mb.inc
require conf/machine/include/dreambox-part-64mb.inc
require conf/machine/include/dreambox-jffs2.inc
require conf/machine/include/dreambox-mipsel.inc
require conf/machine/include/dreambox-legacy-wlan.inc
```

## meta-opendreambox/conf/distro/opendreambox.conf
```bitbake
#@TYPE: Distribution
#@NAME: OpenDreambox
#@DESCRIPTION: Distribution configuration for OpenDreambox

#INHERIT += "opendreambox-mirrors"
QA_LOG = "1"
INHERIT += "recipe_sanity"
INHERIT += "testlab"
INHERIT += "buildhistory"
BUILDHISTORY_COMMIT = "1"

SYSVINIT_ENABLED_GETTYS = ""
DISTRO = "opendreambox"
DISTRO_NAME = "OpenDreambox"
DISTRO_VERSION = "2.0.0"
DISTRO_PR ?= ""

# busybox-config.inc
DISTRO_FEATURES += "3g alsa bluetooth directfb gtk-directfb ext2 largefile mplt nfs pci ppp smbfs usbhost zeroconf pci ${DISTRO_FEATURES_LIBC}"

# for image.bbclass:
# busybox' blkid is broken as of 1.18, but master seems to contain better code.
IMAGE_INIT_MANAGER ?= "sysvinit sysvinit-pidof"
IMAGE_LOGIN_MANAGER ?= "busybox"
IMAGE_FSTYPES += "tar.bz2"

# for distro-feed-configs:
DISTRO_FEED_PREFIX ?= "official"
DISTRO_FEED_URI ?= "http://dreamboxupdate.com/${DISTRO}/${DISTRO_VERSION}/experimental"

# own-mirrors.bbclass
#INHERIT += "own-mirrors"
#SOURCE_MIRROR_URL ?= "http://dreamboxupdate.com/sources-mirror/"

# package versions
OPENDREAMBOX_QT_VERSION = "4.8.0"

PREFERRED_VERSION_enigma2 ?= "3.2git20111110"
PREFERRED_VERSION_qt4-native ?= "${OPENDREAMBOX_QT_VERSION}"
PREFERRED_VERSION_qt4-tools-sdk ?= "${OPENDREAMBOX_QT_VERSION}"
PREFERRED_VERSION_qt4-embedded ?= "${OPENDREAMBOX_QT_VERSION}"
PREFERRED_VERSION_qt4-embedded-gles ?= "${OPENDREAMBOX_QT_VERSION}"
PREFERRED_VERSION_qt4-x11-free = "${OPENDREAMBOX_QT_VERSION}"
PREFERRED_VERSION_qt4-x11-free-gles ?= "${OPENDREAMBOX_QT_VERSION}"
PREFERRED_VERSION_pango ?= "1.28.4"
PREFERRED_VERSION_samba ?= "3.0.37"
PREFERRED_VERSION_udev ?= "${@base_version_less_or_equal('DREAMBOX_KERNEL_VERSION', '2.6.26', '124', '181', d)}"
PREFERRED_VERSION_wpa-supplicant ?= "0.7.3"

PREFERRED_PROVIDER_jpeg = "jpeg"
PREFERRED_PROVIDER_jpeg-native = "jpeg-native"
PREFERRED_PROVIDER_libfribidi = "libfribidi"
PREFERRED_PROVIDER_qt4-tools-native = "qt4-native"
PREFERRED_PROVIDER_virtual/libqte2 = "qte"
PREFERRED_PROVIDER_virtual/libsdl = "libsdl-directfb"

PREFERRED_PROVIDERS += "virtual/${TARGET_PREFIX}gcc-initial:gcc-cross-initial"
PREFERRED_PROVIDERS += "virtual/${TARGET_PREFIX}gcc-intermediate:gcc-cross-intermediate"
PREFERRED_PROVIDERS += "virtual/${TARGET_PREFIX}gcc:gcc-cross"
PREFERRED_PROVIDERS += "virtual/${TARGET_PREFIX}g++:gcc-cross"

LICENSE_FLAGS_WHITELIST = "commercial_gst-plugins-ugly commercial_lame commercial_libmad commercial_mpeg2dec"
COMMERCIAL_AUDIO_PLUGINS ?= "gst-plugins-ugly-mad gst-plugins-ugly-mpegaudioparse"
COMMERCIAL_VIDEO_PLUGINS ?= "gst-plugins-ugly-mpeg2dec gst-plugins-ugly-mpegstream gst-plugins-bad-mpegvideoparse"

# Disable installing ldconfig
USE_LDCONFIG = "0"

TCLIBC = "eglibc"
TCLIBCAPPEND = ""

QEMU_TARGETS ?= "mipsel"

PREMIRRORS ?= "\
bzr://.*/.*   http://dreamboxupdate.com/sources-mirror/ \n \
cvs://.*/.*   http://dreamboxupdate.com/sources-mirror/ \n \
git://.*/.*   http://dreamboxupdate.com/sources-mirror/ \n \
hg://.*/.*    http://dreamboxupdate.com/sources-mirror/ \n \
osc://.*/.*   http://dreamboxupdate.com/sources-mirror/ \n \
p4://.*/.*    http://dreamboxupdate.com/sources-mirror/ \n \
svk://.*/.*   http://dreamboxupdate.com/sources-mirror/ \n \
svn://.*/.*   http://dreamboxupdate.com/sources-mirror/ \n \
bzr://.*/.*   http://autobuilder.yoctoproject.org/sources/ \n \
cvs://.*/.*   http://autobuilder.yoctoproject.org/sources/ \n \
git://.*/.*   http://autobuilder.yoctoproject.org/sources/ \n \
hg://.*/.*    http://autobuilder.yoctoproject.org/sources/ \n \
osc://.*/.*   http://autobuilder.yoctoproject.org/sources/ \n \
p4://.*/.*    http://autobuilder.yoctoproject.org/sources/ \n \
svk://.*/.*   http://autobuilder.yoctoproject.org/sources/ \n \
svn://.*/.*   http://autobuilder.yoctoproject.org/sources/ \n"

MIRRORS =+ "\
ftp://.*/.*    http://dreamboxupdate.com/sources-mirror/ \n \
http://.*/.*   http://dreamboxupdate.com/sources-mirror/ \n \
https://.*/.*  http://dreamboxupdate.com/sources-mirror/ \n \
ftp://.*/.*    http://autobuilder.yoctoproject.org/sources/ \n \
http://.*/.*   http://autobuilder.yoctoproject.org/sources/ \n \
https://.*/.*  http://autobuilder.yoctoproject.org/sources/ \n"
```
